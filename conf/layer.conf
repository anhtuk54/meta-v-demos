## conf/layer.conf
```bitbake
# We have a conf and classes directory, add to BBPATH
BBPATH .= ":${LAYERDIR}"

# We have recipes-* directories, add to BBFILES
BBFILES += "${LAYERDIR}/recipes-*/*/*.bb \
            ${LAYERDIR}/recipes-*/*/*.bbappend"

BBFILE_COLLECTIONS += "meta-v-demos"
BBFILE_PATTERN_meta-v-demos = "^${LAYERDIR}/"
BBFILE_PRIORITY_meta-v-demos = "6"

LAYERDEPENDS_meta-v-demos = "core"
LAYERSERIES_COMPAT_meta-v-demos = "scarthgap"
```
